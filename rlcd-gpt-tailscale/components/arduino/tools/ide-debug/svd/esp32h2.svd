# ESP32-H2 register map
Vendor: ESPRESSIF SYSTEMS (SHANGHAI) CO., LTD.; Series: ESP32 H-Series; File version: 1
CPU: RV32IMC r0p0, little endian, no MPU, no FPU, 4 interrupt priority bits
Address unit: 32 bits
Registers are 32-bit, read-write, reset 0x0 unless marked. A register's access mark holds for its fields unless they carry their own. Offsets are from the block's base; [hi:lo] are bit positions; {n}, {i} and the like mark numbered series.

## RNG — Hardware random number generator
Base 0x600260B0
0x00 DATA access not given — Random number data

## RSA — RSA (Rivest Shamir Adleman) Accelerator
Base 0x6003C000
{0x0+i} M_MEM[{i}] (i=0..15) 8-bit access not given — Represents M
{0x200+i} Z_MEM[{i}] (i=0..15) 8-bit access not given — Represents Z
{0x400+i} Y_MEM[{i}] (i=0..15) 8-bit access not given — Represents Y
{0x600+i} X_MEM[{i}] (i=0..15) 8-bit access not given — Represents X
0x800 M_PRIME — Represents M’
0x804 MODE — Configures RSA length
  [6:0] MODE — Configures the RSA length.
0x808 QUERY_CLEAN ro — RSA clean register
  [0] QUERY_CLEAN — Represents whether or not the RSA memory completes initialization. 0: Not complete 1: Completed
0x80C SET_START_MODEXP wo — Starts modular exponentiation
  [0] SET_START_MODEXP — Configure whether or not to start the modular exponentiation. 0: No effect 1: Start
0x810 SET_START_MODMULT wo — Starts modular multiplication
  [0] SET_START_MODMULT — Configure whether or not to start the modular multiplication. 0: No effect 1: Start
0x814 SET_START_MULT wo — Starts multiplication
  [0] SET_START_MULT — Configure whether or not to start the multiplication. 0: No effect 1: Start
0x818 QUERY_IDLE ro — Represents the RSA status
  [0] QUERY_IDLE — Represents the RSA status. 0: Busy 1: Idle
0x81C INT_CLR wo — Clears RSA interrupt
  [0] CLEAR_INTERRUPT — Write 1 to clear the RSA interrupt.
0x820 CONSTANT_TIME reset 0x1 — Configures the constant_time option
  [0] CONSTANT_TIME — Configures the constant_time option. 0: Acceleration 1: No acceleration (default)
0x824 SEARCH_ENABLE — Configures the search option
  [0] SEARCH_ENABLE — Configure the search option. 0: No acceleration (default) 1: Acceleration This option should be used together with RSA_SEARCH_POS.
0x828 SEARCH_POS — Configures the search position
  [11:0] SEARCH_POS — Configures the starting address to start search. This field should be used together with RSA_SEARCH_ENABLE. The field is only valid when RSA_SEARCH_ENABLE is high.
0x82C INT_ENA — Enables the RSA interrupt
  [0] INT_ENA — Write 1 to enable the RSA interrupt.
0x830 DATE reset 0x20200618 — Version control register
  [29:0] DATE — Version control register.

## SHA — SHA (Secure Hash Algorithm) Accelerator
Base 0x6003B000
0x00 MODE — Initial configuration register.
  [2:0] MODE — Sha mode.
0x04 T_STRING — SHA 512/t configuration register 0.
  [31:0] T_STRING — Sha t_string (used if and only if mode == SHA_512/t).
0x08 T_LENGTH — SHA 512/t configuration register 1.
  [5:0] T_LENGTH — Sha t_length (used if and only if mode == SHA_512/t).
0x0C DMA_BLOCK_NUM — DMA configuration register 0.
  [5:0] DMA_BLOCK_NUM — Dma-sha block number.
0x10 START ro — Typical SHA configuration register 0.
  [31:1] START — Reserved.
0x14 CONTINUE ro — Typical SHA configuration register 1.
  [31:1] CONTINUE — Reserved.
0x18 BUSY ro
  [0] STATE — Sha busy state. 1'b0: idle. 1'b1: busy.
0x1C DMA_START wo — DMA configuration register 1.
  [0] DMA_START — Start dma-sha.
0x20 DMA_CONTINUE wo — DMA configuration register 2.
  [0] DMA_CONTINUE — Continue dma-sha.
0x24 CLEAR_IRQ wo — Interrupt clear register.
  [0] CLEAR_INTERRUPT — Clear sha interrupt.
0x28 IRQ_ENA — Interrupt enable register.
  [0] INTERRUPT_ENA — Sha interrupt enable register. 1'b0: disable(default). 1'b1: enable.
0x2C DATE reset 0x20201229
  [29:0] DATE — Sha date information/ sha version information.
{0x40+i} H_MEM[{i}] (i=0..63) 8-bit access not given — Sha H memory which contains intermediate hash or finial hash.
{0x80+i} M_MEM[{i}] (i=0..63) 8-bit access not given — Sha M memory which contains message.

## TEE — Peripheral TEE
Base 0x60098000
0x00 M0_MODE_CTRL — Tee mode control register
  [1:0] M0_MODE — M0 security level mode: 2'd3: ree_mode2. 2'd2: ree_mode1. 2'd1: ree_mode0. 2'd0: tee_mode
0x04 M1_MODE_CTRL reset 0x3 — Tee mode control register
  [1:0] M1_MODE — M1 security level mode: 2'd3: ree_mode2. 2'd2: ree_mode1. 2'd1: ree_mode0. 2'd0: tee_mode
0x08 M2_MODE_CTRL — Tee mode control register
  [1:0] M2_MODE — M2 security level mode: 2'd3: ree_mode2. 2'd2: ree_mode1. 2'd1: ree_mode0. 2'd0: tee_mode
{0x0+4i} M{i}_MODE_CTRL reset 0x3 (i=3..31) — Tee mode control register
  [1:0] M{i}_MODE — M{i} security level mode: 2'd3: ree_mode2. 2'd2: ree_mode1. 2'd1: ree_mode0. 2'd0: tee_mode
0x80 CLOCK_GATE reset 0x1 — Clock gating register
  [0] CLK_EN — reg_clk_en
0xFFC DATE reset 0x2205282 — Version register
  [27:0] DATE — reg_tee_date
